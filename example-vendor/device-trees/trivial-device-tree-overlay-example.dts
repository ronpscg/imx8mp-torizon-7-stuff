/dts-v1/;
/plugin/;

/ {
    fragment@0 {
        target-path = "/";

        __overlay__ {
            ron = "munitz";
	    thepscg = "rocks";
	    model = "The PSCG amazing Toradex model. Wow!";
        };
    };
};
